/* Script for --shared -z combreloc: shared library, combine & sort relocs */

OUTPUT_FORMAT("elf64-littleaarch64", "elf64-bigaarch64",
	      "elf64-littleaarch64")
OUTPUT_ARCH(aarch64)
SEARCH_DIR("=/usr/local/lib/aarch64-linux-gnu"); SEARCH_DIR("=/lib/aarch64-linux-gnu"); SEARCH_DIR("=/usr/lib/aarch64-linux-gnu"); SEARCH_DIR("=/usr/local/lib"); SEARCH_DIR("=/lib"); SEARCH_DIR("=/usr/lib"); SEARCH_DIR("=/usr/aarch64-linux-gnu/lib");SEARCH_DIR("=/usr/lib64");SEARCH_DIR("=/usr/local/lib64"); SEARCH_DIR("=/lib64");
SECTIONS
{
  /* Read-only sections, merged into text segment: */
  . = SEGMENT_START("text-segment", 0) + SIZEOF_HEADERS;
  .note.gnu.build-id : { *(.note.gnu.build-id) }
  .hash           : { *(.hash) }
  .gnu.hash       : { *(.gnu.hash) }
  .dynsym         : { *(.dynsym) }
  .dynstr         : { *(.dynstr) }
  .gnu.version    : { *(.gnu.version) }
  .gnu.version_d  : { *(.gnu.version_d) }
  .gnu.version_r  : { *(.gnu.version_r) }
  .rela.dyn       :
    {
      *(.rela.init)
      *(.rela.text .rela.text.* .rela.gnu.linkonce.t.*)
      *(.rela.fini)
      *(.rela.rodata .rela.rodata.* .rela.gnu.linkonce.r.*)
      *(.rela.data .rela.data.* .rela.gnu.linkonce.d.*)
      *(.rela.tdata .rela.tdata.* .rela.gnu.linkonce.td.*)
      *(.rela.tbss .rela.tbss.* .rela.gnu.linkonce.tb.*)
      *(.rela.ctors)
      *(.rela.dtors)
      *(.rela.got)
      *(.rela.bss .rela.bss.* .rela.gnu.linkonce.b.*)
      *(.rela.ifunc)
    }
  .rela.plt       :
    {
      *(.rela.plt)
      *(.rela.iplt)
    }
  .init           :
  {
    KEEP (*(SORT_NONE(.init)))
  } =0
  .plt            : ALIGN(16) { *(.plt) *(.iplt) }
  .text           :
  {
    *(.text.unlikely .text.*_unlikely .text.unlikely.*)
    *(.text.exit .text.exit.*)
    *(.text.startup .text.startup.*)
    *(.text.hot .text.hot.*)
    *(.text .stub .gnu.linkonce.t.*)
    *(SORT(.text.*))
    /* .cjinit_function sections follows the text section. */
    *(.cjinit_function .cjinit_function.*)
    /* .gnu.warning sections are handled specially by elf32.em.  */
    *(.gnu.warning)
  } =0
  .fini           :
  {
    KEEP (*(SORT_NONE(.fini)))
  } =0
  PROVIDE (__etext = .);
  PROVIDE (_etext = .);
  PROVIDE (etext = .);
  .rodata         : { *(.rodata .rodata.* .gnu.linkonce.r.*) }
  .rodata1        : { *(.rodata1) }
  .eh_frame_hdr : { *(.eh_frame_hdr) *(.eh_frame_entry .eh_frame_entry.*) }
  .eh_frame       : ONLY_IF_RO { KEEP (*(.eh_frame)) *(.eh_frame.*) }
  .gcc_except_table   : ONLY_IF_RO { *(.gcc_except_table
  .gcc_except_table.*) }
  .gnu_extab   : ONLY_IF_RO { *(.gnu_extab*) }
  /* These sections are generated by the Sun/Oracle C++ compiler.  */
  .exception_ranges   : ONLY_IF_RO { *(.exception_ranges
  .exception_ranges*) }
  /* Adjust the address for the data segment.  We want to adjust up to
     the same address within the page on the next page up.  */
  . = DATA_SEGMENT_ALIGN (CONSTANT (MAXPAGESIZE), CONSTANT (COMMONPAGESIZE));
  /* Exception handling  */
  .eh_frame       : ONLY_IF_RW { KEEP (*(.eh_frame)) *(.eh_frame.*) }
  .gnu_extab      : ONLY_IF_RW { *(.gnu_extab) }
  .gcc_except_table   : ONLY_IF_RW { *(.gcc_except_table .gcc_except_table.*) }
  .exception_ranges   : ONLY_IF_RW { *(.exception_ranges .exception_ranges*) }
  /* Thread Local Storage sections  */
  .tdata	  : { *(.tdata .tdata.* .gnu.linkonce.td.*) }
  .tbss		  : { *(.tbss .tbss.* .gnu.linkonce.tb.*) *(.tcommon) }
  .preinit_array     :
  {
    KEEP (*(.preinit_array))
  }
  .init_array     :
  {
    KEEP (*(SORT_BY_INIT_PRIORITY(.init_array.*) SORT_BY_INIT_PRIORITY(.ctors.*)))
    KEEP (*(.init_array EXCLUDE_FILE (*crtbegin.o *crtbegin?.o *crtend.o *crtend?.o ) .ctors))
  }
  .fini_array     :
  {
    KEEP (*(SORT_BY_INIT_PRIORITY(.fini_array.*) SORT_BY_INIT_PRIORITY(.dtors.*)))
    KEEP (*(.fini_array EXCLUDE_FILE (*crtbegin.o *crtbegin?.o *crtend.o *crtend?.o ) .dtors))
  }
  .ctors          :
  {
    /* gcc uses crtbegin.o to find the start of
       the constructors, so we make sure it is
       first.  Because this is a wildcard, it
       doesn't matter if the user does not
       actually link against crtbegin.o; the
       linker won't look for a file to match a
       wildcard.  The wildcard also means that it
       doesn't matter which directory crtbegin.o
       is in.  */
    KEEP (*crtbegin.o(.ctors))
    KEEP (*crtbegin?.o(.ctors))
    /* We don't want to include the .ctor section from
       the crtend.o file until after the sorted ctors.
       The .ctor section from the crtend file contains the
       end of ctors marker and it must be last */
    KEEP (*(EXCLUDE_FILE (*crtend.o *crtend?.o ) .ctors))
    KEEP (*(SORT(.ctors.*)))
    KEEP (*(.ctors))
  }
  .dtors          :
  {
    KEEP (*crtbegin.o(.dtors))
    KEEP (*crtbegin?.o(.dtors))
    KEEP (*(EXCLUDE_FILE (*crtend.o *crtend?.o ) .dtors))
    KEEP (*(SORT(.dtors.*)))
    KEEP (*(.dtors))
  }
  .jcr            : { KEEP (*(.jcr)) }
  .data.rel.ro : { *(.data.rel.ro.local* .gnu.linkonce.d.rel.ro.local.*) *(.data.rel.ro .data.rel.ro.* .gnu.linkonce.d.rel.ro.*) }
  .dynamic        : { *(.dynamic) }
  .got            : { *(.got) *(.igot) }
  . = DATA_SEGMENT_RELRO_END (24, .);
  .got.plt        : { *(.got.plt)  *(.igot.plt) }
  .data           :
  {
    PROVIDE (__data_start = .);
    *(.data .data.* .gnu.linkonce.d.*)
    SORT(CONSTRUCTORS)
  }
  .data1          : { *(.data1) }
  /* Cangjie Metadata sections start */
  . = ALIGN(16);
  _CJMetadataStart = .;
  PROVIDE_HIDDEN(__CJMetadataStart = .);
  .cjmetadata : {
      KEEP(*cjstart.o(.cjmetadata.rw.header))

      . = ALIGN(16);
      PROVIDE_HIDDEN(__CJSDKVersion = . - __CJMetadataStart);
      KEEP(*(.cjmetadata.sdk.version))
      KEEP(*(SORT(.cjmetadata.sdk.version.*)))
      PROVIDE_HIDDEN(__CJSDKVersionEnd = . - __CJMetadataStart);

      . = ALIGN(16);
      PROVIDE_HIDDEN(__CJMethodInfo = . - __CJMetadataStart);
      KEEP(*(.cjmetadata.methodinfo))
      KEEP(*(SORT(.cjmetadata.methodinfo.*)))
      PROVIDE_HIDDEN(__CJMethodInfoEnd = . - __CJMetadataStart);

      . = ALIGN(16);
      PROVIDE_HIDDEN(__CJGlobalInitFunc = . - __CJMetadataStart);
      KEEP(*(.cjmetadata.globalInitFunc))
      KEEP(*(SORT(.cjmetadata.globalInitFunc.*)))
      PROVIDE_HIDDEN(__CJGlobalInitFuncEnd = . - __CJMetadataStart);

      . = ALIGN(16);
      PROVIDE_HIDDEN(__CJStringPoolDict = . - __CJMetadataStart);
      KEEP(*(.cjmetadata.stringpooldict))
      KEEP(*(SORT(.cjmetadata.stringpooldict.*)))
      PROVIDE_HIDDEN(__CJStringPoolDictEnd = . - __CJMetadataStart);

      . = ALIGN(16);
      PROVIDE_HIDDEN(__CJStringPool = . - __CJMetadataStart);
      KEEP(*(.cjmetadata.stringpool))
      KEEP(*(SORT(.cjmetadata.stringpool.*)))
      PROVIDE_HIDDEN(__CJStringPoolEnd = . - __CJMetadataStart);

      . = ALIGN(16);
      PROVIDE_HIDDEN(__CJStackMap = . - __CJMetadataStart);
      KEEP(*(.cjmetadata.stackmap))
      KEEP(*(SORT(.cjmetadata.stackmap.*)))
      PROVIDE_HIDDEN(__CJStackMapEnd = . - __CJMetadataStart);

      . = ALIGN(16);
      PROVIDE_HIDDEN(__CJGCTib = . - __CJMetadataStart);
      KEEP(*(.cjmetadata.gctib))
      KEEP(*(SORT(.cjmetadata.gctib.*)))
      PROVIDE_HIDDEN(__CJGCTibEnd = . - __CJMetadataStart);

      . = ALIGN(16);
      PROVIDE_HIDDEN(__CJGCRoots = . - __CJMetadataStart);
      KEEP(*(.cjmetadata.gcroots))
      KEEP(*(SORT(.cjmetadata.gcroots.*)))
      PROVIDE_HIDDEN(__CJGCRootsEnd = . - __CJMetadataStart);

      . = ALIGN(16);
      PROVIDE_HIDDEN(__CJTypeTemplate = . - __CJMetadataStart);
      KEEP(*(.cjmetadata.typetemplate))
      KEEP(*(SORT(.cjmetadata.typetemplate.*)))
      PROVIDE_HIDDEN(__CJTypeTemplateEnd = . - __CJMetadataStart);

      . = ALIGN(16);
      PROVIDE_HIDDEN(__CJTypeInfo = . - __CJMetadataStart);
      KEEP(*(.cjmetadata.typeinfo))
      KEEP(*(SORT(.cjmetadata.typeinfo.*)))
      PROVIDE_HIDDEN(__CJTypeInfoEnd = . - __CJMetadataStart);

      . = ALIGN(16);
      PROVIDE_HIDDEN(__CJTypeFields = . - __CJMetadataStart);
      KEEP(*(.cjmetadata.type.fields))
      KEEP(*(SORT(.cjmetadata.type.fields.*)))
      PROVIDE_HIDDEN(__CJTypeFieldsEnd = . - __CJMetadataStart);

      . = ALIGN(16);
      PROVIDE_HIDDEN(__CJMTable = . - __CJMetadataStart);
      KEEP(*(.cjmetadata.mtable))
      KEEP(*(SORT(.cjmetadata.mtable.*)))
      PROVIDE_HIDDEN(__CJMTableEnd = . - __CJMetadataStart);

      . = ALIGN(16);
      PROVIDE_HIDDEN(__CJInnerTypeExtensions = . - __CJMetadataStart);
      KEEP(*(.cjmetadata.innerty.eds))
      KEEP(*(SORT(.cjmetadata.innerty.eds.*)))
      PROVIDE_HIDDEN(__CJInnerTypeExtensionsEnd = . - __CJMetadataStart);

      . = ALIGN(16);
      PROVIDE_HIDDEN(__CJOuterTypeExtensions = . - __CJMetadataStart);
      KEEP(*(.cjmetadata.outerty.eds))
      KEEP(*(SORT(.cjmetadata.outerty.eds.*)))
      PROVIDE_HIDDEN(__CJOuterTypeExtensionsEnd = . - __CJMetadataStart);

      . = ALIGN(16);
      PROVIDE_HIDDEN(__CJStaticGITable = . - __CJMetadataStart);
      KEEP(*(.cjmetadata.static.generic.ti))
      KEEP(*(SORT(.cjmetadata.static.generic.ti.*)))
      PROVIDE_HIDDEN(__CJStaticGITableEnd = . - __CJMetadataStart);

      . = ALIGN(16);
      PROVIDE_HIDDEN(__CJGCFlags = . - __CJMetadataStart);
      KEEP(*(.cjmetadata.gcflags))
      PROVIDE_HIDDEN(__CJGCFlagsEnd = . - __CJMetadataStart);

      . = ALIGN(16);
      PROVIDE_HIDDEN(__CJReflectPkgInfo = . - __CJMetadataStart);
      KEEP(*(.cjmetadata.reflect.pkginfo))
      KEEP(*(SORT(.cjmetadata.reflect.pkginfo.*)))
      PROVIDE_HIDDEN(__CJReflectPkgInfoEnd = . - __CJMetadataStart);

      . = ALIGN(16);
      PROVIDE_HIDDEN(__CJReflectGV = . - __CJMetadataStart);
      KEEP(*(.cjmetadata.reflect.gv))
      KEEP(*(SORT(.cjmetadata.reflect.gv.*)))
      PROVIDE_HIDDEN(__CJReflectGVEnd = . - __CJMetadataStart);

      . = ALIGN(16);
      PROVIDE_HIDDEN(__CJReflectGI = . - __CJMetadataStart);
      KEEP(*(.cjmetadata.reflect.generic.ti))
      KEEP(*(SORT(.cjmetadata.reflect.generic.ti.*)))
      PROVIDE_HIDDEN(__CJReflectGIEnd = . - __CJMetadataStart);
  }
  PROVIDE_HIDDEN(__CJMethodInfoSize = __CJMethodInfoEnd - __CJMethodInfo);
  PROVIDE_HIDDEN(__CJGlobalInitFuncSize = __CJGlobalInitFuncEnd - __CJGlobalInitFunc);
  PROVIDE_HIDDEN(__CJStringPoolDictSize = __CJStringPoolDictEnd - __CJStringPoolDict);
  PROVIDE_HIDDEN(__CJStringPoolSize = __CJStringPoolEnd - __CJStringPool);
  PROVIDE_HIDDEN(__CJStackMapSize   = __CJStackMapEnd - __CJStackMap);
  PROVIDE_HIDDEN(__CJGCTibSize      = __CJGCTibEnd - __CJGCTib);
  PROVIDE_HIDDEN(__CJGCRootsSize    = __CJGCRootsEnd - __CJGCRoots);
  PROVIDE_HIDDEN(__CJTypeTemplateSize  = __CJTypeTemplateEnd - __CJTypeTemplate);
  PROVIDE_HIDDEN(__CJTypeInfoSize  = __CJTypeInfoEnd - __CJTypeInfo);
  PROVIDE_HIDDEN(__CJTypeFieldsSize  = __CJTypeFieldsEnd - __CJTypeFields);
  PROVIDE_HIDDEN(__CJMTableSize     = __CJMTableEnd - __CJMTable);
  PROVIDE_HIDDEN(__CJInnerTypeExtensionsSize = __CJInnerTypeExtensionsEnd - __CJInnerTypeExtensions);
  PROVIDE_HIDDEN(__CJOuterTypeExtensionsSize = __CJOuterTypeExtensionsEnd - __CJOuterTypeExtensions);
  PROVIDE_HIDDEN(__CJStaticGITableSize = __CJStaticGITableEnd - __CJStaticGITable);
  PROVIDE_HIDDEN(__CJGCFlagsSize = __CJGCFlagsEnd - __CJGCFlags);
  PROVIDE_HIDDEN(__CJGCReflectPkgInfoSize = __CJReflectPkgInfoEnd - __CJReflectPkgInfo);
  PROVIDE_HIDDEN(__CJReflectGVSize = __CJReflectGVEnd - __CJReflectGV);
  PROVIDE_HIDDEN(__CJReflectGISize = __CJReflectGIEnd - __CJReflectGI);
  PROVIDE_HIDDEN(__CJMetaDataSize = . - __CJMetadataStart);
  /* Cangjie Metadata sections end */
  _edata = .; PROVIDE (edata = .);
  . = .;
  __bss_start = .;
  __bss_start__ = .;
  .bss            :
  {
   *(.dynbss)
   *(.bss .bss.* .gnu.linkonce.b.*)
   *(COMMON)
   /* Align here to ensure that the .bss section occupies space up to
      _end.  Align after .bss to ensure correct alignment even if the
      .bss section disappears because there are no input sections. */
   . = ALIGN(. != 0 ? 64 / 8 : 1);
  }
  _bss_end__ = . ; __bss_end__ = . ;
  . = ALIGN(64 / 8);
  . = SEGMENT_START("ldata-segment", .);
  . = ALIGN(64 / 8);
  __end__ = . ;
  _end = .; PROVIDE (end = .);
  . = DATA_SEGMENT_END (.);
  /* Stabs debugging sections.  */
  .stab          0 : { *(.stab) }
  .stabstr       0 : { *(.stabstr) }
  .stab.excl     0 : { *(.stab.excl) }
  .stab.exclstr  0 : { *(.stab.exclstr) }
  .stab.index    0 : { *(.stab.index) }
  .stab.indexstr 0 : { *(.stab.indexstr) }
  .comment       0 : { *(.comment) }
  /* DWARF debug sections.
     Symbols in the DWARF debugging sections are relative to the beginning
     of the section so we begin them at 0.  */
  /* DWARF 1 */
  .debug          0 : { *(.debug) }
  .line           0 : { *(.line) }
  /* GNU DWARF 1 extensions */
  .debug_srcinfo  0 : { *(.debug_srcinfo) }
  .debug_sfnames  0 : { *(.debug_sfnames) }
  /* DWARF 1.1 and DWARF 2 */
  .debug_aranges  0 : { *(.debug_aranges) }
  .debug_pubnames 0 : { *(.debug_pubnames) }
  /* DWARF 2 */
  .debug_info     0 : { *(.debug_info .gnu.linkonce.wi.*) }
  .debug_abbrev   0 : { *(.debug_abbrev) }
  .debug_line     0 : { *(.debug_line .debug_line.* .debug_line_end ) }
  .debug_frame    0 : { *(.debug_frame) }
  .debug_str      0 : { *(.debug_str) }
  .debug_loc      0 : { *(.debug_loc) }
  .debug_macinfo  0 : { *(.debug_macinfo) }
  /* SGI/MIPS DWARF 2 extensions */
  .debug_weaknames 0 : { *(.debug_weaknames) }
  .debug_funcnames 0 : { *(.debug_funcnames) }
  .debug_typenames 0 : { *(.debug_typenames) }
  .debug_varnames  0 : { *(.debug_varnames) }
  /* DWARF 3 */
  .debug_pubtypes 0 : { *(.debug_pubtypes) }
  .debug_ranges   0 : { *(.debug_ranges) }
  /* DWARF Extension.  */
  .debug_macro    0 : { *(.debug_macro) }
  .debug_addr     0 : { *(.debug_addr) }
  .ARM.attributes 0 : { KEEP (*(.ARM.attributes)) KEEP (*(.gnu.attributes)) }
  .note.gnu.arm.ident 0 : { KEEP (*(.note.gnu.arm.ident)) }
  /DISCARD/ : { *(.note.GNU-stack) *(.gnu_debuglink) *(.gnu.lto_*) }
}
